## distro/Config.in
```kconfig
source "$BR2_EXTERNAL_TRUNCATED_CUBE_LINUX_PATH/package/caddy/Config.in"
source "$BR2_EXTERNAL_TRUNCATED_CUBE_LINUX_PATH/package/qt5httpserver/Config.in"
source "$BR2_EXTERNAL_TRUNCATED_CUBE_LINUX_PATH/package/truncated_cube_lamp_service/Config.in"
```

## distro/configs/truncated-cube-lamp_defconfig
```kconfig
BR2_aarch64=y
BR2_ARM_FPU_VFPV4=y
BR2_TOOLCHAIN_BUILDROOT_GLIBC=y
BR2_PACKAGE_HOST_LINUX_HEADERS_CUSTOM_5_10=y
BR2_TOOLCHAIN_BUILDROOT_CXX=y
BR2_TARGET_GENERIC_HOSTNAME="TruncatedCubeLamp"
BR2_TARGET_GENERIC_ISSUE="Welcome to Truncated Cube Lamp"
BR2_INIT_SYSTEMD=y
BR2_SYSTEM_DHCP="eth0"
BR2_SYSTEM_DEFAULT_PATH="/bin:/sbin:/usr/bin:/usr/sbin"
BR2_ROOTFS_OVERLAY="$(BR2_EXTERNAL_TRUNCATED_CUBE_LINUX_PATH)/board/mercotui/truncated-cube-lamp/rootfs_overlay $(BR2_EXTERNAL_TRUNCATED_CUBE_LINUX_PATH)/board/mercotui/truncated-cube-lamp/rootfs_secrets_overlay"
BR2_ROOTFS_POST_BUILD_SCRIPT="board/raspberrypi3-64/post-build.sh"
BR2_ROOTFS_POST_IMAGE_SCRIPT="board/raspberrypi3-64/post-image.sh"
BR2_LINUX_KERNEL=y
BR2_LINUX_KERNEL_CUSTOM_TARBALL=y
BR2_LINUX_KERNEL_CUSTOM_TARBALL_LOCATION="$(call github,raspberrypi,linux,0b54dbda3cca2beb51e236a25738784e90853b64)/linux-0b54dbda3cca2beb51e236a25738784e90853b64.tar.gz"
BR2_LINUX_KERNEL_DEFCONFIG="bcmrpi3"
BR2_LINUX_KERNEL_DTS_SUPPORT=y
BR2_LINUX_KERNEL_INTREE_DTS_NAME="broadcom/bcm2710-rpi-3-b broadcom/bcm2710-rpi-3-b-plus broadcom/bcm2837-rpi-3-b"
BR2_LINUX_KERNEL_NEEDS_HOST_OPENSSL=y
BR2_PACKAGE_RPI_FIRMWARE=y
BR2_PACKAGE_RPI_FIRMWARE_BOOTCODE_BIN=y
BR2_PACKAGE_RPI_FIRMWARE_VARIANT_PI=y
BR2_PACKAGE_RPI_FIRMWARE_CONFIG_FILE="$(BR2_EXTERNAL_TRUNCATED_CUBE_LINUX_PATH)/board/mercotui/truncated-cube-lamp/kernel-config.txt"
BR2_PACKAGE_PIGPIO=y
BR2_PACKAGE_RASPI_GPIO=y
BR2_PACKAGE_OPENSSH=y
BR2_PACKAGE_VIM=y
BR2_TARGET_ROOTFS_EXT2=y
BR2_TARGET_ROOTFS_EXT2_4=y
BR2_TARGET_ROOTFS_EXT2_SIZE="250M"
# BR2_TARGET_ROOTFS_TAR is not set
BR2_PACKAGE_HOST_DOSFSTOOLS=y
BR2_PACKAGE_HOST_GENIMAGE=y
BR2_PACKAGE_HOST_MTOOLS=y
BR2_PACKAGE_TRUNCATED_CUBE_LAMP_SERVICE=y
```

## distro/package/caddy/Config.in
```kconfig
config BR2_PACKAGE_CADDY
        bool "caddy server"
        help
          Caddy 2 is a powerful, enterprise-ready, open source web server
          with automatic HTTPS written in Go.
```

## distro/package/powerbutton/Config.in
```kconfig
config BR2_PACKAGE_POWERBUTTON
        bool "Powerbutton"
        depends on BR2_PACKAGE_PYTHON3
        select BR2_PACKAGE_PYTHON_RPI_GPIO
        help
          A powerbutton service written in python, using gpio and systemd.
```

## distro/package/qt5httpserver/Config.in
```kconfig
config BR2_PACKAGE_QT5HTTPSERVER
        bool "Truncated Cube Lamp Service"
        select BR2_PACKAGE_QT5
        help
          Qt Extension: Qt HTTP Server
```

## distro/package/truncated_cube_lamp_service/Config.in
```kconfig
config BR2_PACKAGE_TRUNCATED_CUBE_LAMP_SERVICE
        bool "Truncated Cube Lamp Service"
        select BR2_PACKAGE_QT5
        select BR2_PACKAGE_QT5DECLARATIVE
        select BR2_PACKAGE_QT5BASE_GUI
        select BR2_PACKAGE_QT5HTTPSERVER
        help
          The backend service for the truncated cube lamp API.
```

## distro/package/truncated_cube_lamp_website/Config.in
```kconfig
config BR2_PACKAGE_TRUNCATED_CUBE_LAMP_WEBSITE
        bool "Truncated Cube Lamp Website"
        help
          The frontend for the truncated cube lamp.
```
